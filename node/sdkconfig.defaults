## node/sdkconfig.defaults
```kconfig
# Enable Bluetooth
CONFIG_BT_ENABLED=y
CONFIG_BTDM_CTRL_MODE_BLE_ONLY=y
CONFIG_BTDM_CTRL_MODE_BR_EDR_ONLY=n
CONFIG_BTDM_CTRL_MODE_BTDM=n

# Enable Bluedroid (Bluetooth stack)
CONFIG_BLUEDROID_ENABLED=y
CONFIG_BTC_TASK_STACK_SIZE=3072
CONFIG_BLUEDROID_MEM_DEBUG=n
CONFIG_BLUEDROID_STACK_CHECK=n

# BLE Options
CONFIG_BLE_SMP_ENABLE=y
CONFIG_BLE_SCAN_DUPLICATE=y
```
